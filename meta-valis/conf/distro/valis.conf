## meta-valis/conf/distro/valis.conf
```bitbake
require conf/distro/poky.conf

DISTRO = "valis"
DISTROOVERRIDES = "poky:valis"
DISTRO_FEATURES_DEFAULT = "ipsec pci systemd usbhost virtualization wifi"

hostname_pn-base-files = "${MACHINE}"

INITRAMFS_IMAGE = "${DISTRO}-initramfs"
INITRAMFS_IMAGE_BUNDLE = "1"
INITRAMFS_FSTYPES = "cpio"

PREFERRED_VERSION_linux-intel = "4.14%"

IMAGE_CLASSES += "qemuboot"
QB_DEFAULT_FSTYPE = "none"
QB_DEFAULT_KERNEL = "bzImage-initramfs-qemux86-64.bin"
QB_KERNEL_CMDLINE_APPEND += "debugshell=3 init=/bin/sh"
```

## meta-valis/conf/layer.conf
```bitbake
BBPATH .= ":${LAYERDIR}"
BBFILES += "${LAYERDIR}/recipes-*/*/*.bb"
BBFILES += "${LAYERDIR}/recipes-*/*/*.bbappend"

BBFILE_COLLECTIONS += "valis"
BBFILE_PATTERN_valis = "^${LAYERDIR}/"
BBFILE_PRIORITY_valis = "10"

LAYERVERSION_valis = "1"
LAYERSERIES_COMPAT_valis = "sumo"
```

## meta-valis/conf/machine/minnowboard-turbot.conf
```bitbake
require conf/machine/intel-corei7-64.conf
MACHINEOVERRIDES =. "intel-corei7-64:"

SERIAL_CONSOLES = "115200;ttyS0"
```
